## config/boards/shields/keypad16/Kconfig.shield
```kconfig
config SHIELD_KEYPAD16
    def_bool $(shields_list_contains, keypad16)

rsource "../../../drivers/kscan/Kconfig"
```

## config/drivers/kscan/Kconfig
```kconfig
# Copyright (c) 2024 The ZMK Contributors
# SPDX-License-Identifier: MIT

config ZMK_KSCAN_VIRTUAL
	bool "Virtual KScan Driver"
	default n
	select INPUT
	help
	  Enable virtual kscan driver that provides software-defined key
	  positions triggered by input events (e.g., from gpio-qdec encoders).
	  Virtual keys appear in ZMK Studio as editable positions.
```

## config/dts/bindings/kscan/zmk,kscan-gpio-encoder.yaml
```yaml
# Copyright (c) 2024 The ZMK Contributors
# SPDX-License-Identifier: MIT

description: GPIO-based rotary encoder kscan driver for ZMK

compatible: "zmk,kscan-gpio-encoder"

include: kscan.yaml

properties:
  a-gpios:
    type: phandle-array
    required: true
    description: |
      Array of GPIO phandles for encoder A pins (quadrature phase A).
      One entry per encoder.

  b-gpios:
    type: phandle-array
    required: true
    description: |
      Array of GPIO phandles for encoder B pins (quadrature phase B).
      One entry per encoder. Must have same length as a-gpios.

  debounce-period-ms:
    type: int
    default: 2
    description: |
      Debounce period in milliseconds to filter encoder noise.

  poll-period-ms:
    type: int
    default: 5
    description: |
      Polling interval in milliseconds for reading encoder state.
```

## config/dts/bindings/kscan/zmk,kscan-gpio-qdec.yaml
```yaml
# Copyright (c) 2024 The ZMK Contributors
# SPDX-License-Identifier: MIT

description: |
  ZMK KScan driver that consumes Zephyr's gpio-qdec input events
  and converts encoder rotations to key matrix events.

  This driver listens to INPUT_REL_* events from gpio-qdec devices
  and emits kscan callbacks, mapping:
    - Row = encoder index (0, 1, 2, ...)
    - Col 0 = CW rotation (positive input value)
    - Col 1 = CCW rotation (negative input value)

  Example usage:

    #include <zephyr/dt-bindings/input/input-event-codes.h>

    encoder_left: encoder_left {
        compatible = "gpio-qdec";
        gpios = <&gpio0 3 (GPIO_PULL_UP | GPIO_ACTIVE_HIGH)>,
                <&gpio0 4 (GPIO_PULL_UP | GPIO_ACTIVE_HIGH)>;
        steps-per-period = <4>;
        zephyr,axis = <INPUT_REL_X>;
        sample-time-us = <2000>;
        idle-timeout-ms = <200>;
    };

    encoder_right: encoder_right {
        compatible = "gpio-qdec";
        gpios = <&gpio0 6 (GPIO_PULL_UP | GPIO_ACTIVE_HIGH)>,
                <&gpio0 7 (GPIO_PULL_UP | GPIO_ACTIVE_HIGH)>;
        steps-per-period = <4>;
        zephyr,axis = <INPUT_REL_Y>;
        sample-time-us = <2000>;
        idle-timeout-ms = <200>;
    };

    encoder_kscan: encoder_kscan {
        compatible = "zmk,kscan-gpio-qdec";
        devices = <&encoder_left &encoder_right>;
        axes = <INPUT_REL_X INPUT_REL_Y>;
    };

compatible: "zmk,kscan-gpio-qdec"

include: kscan.yaml

properties:
  devices:
    type: phandles
    required: true
    description: |
      Array of phandles to gpio-qdec encoder devices.
      The order determines the row index in the key matrix.

  axes:
    type: array
    required: true
    description: |
      Array of INPUT_REL_* axis codes corresponding to each encoder.
      Must have the same length as 'devices'.
      Common values: INPUT_REL_X (0x00), INPUT_REL_Y (0x01), INPUT_REL_WHEEL (0x08)
```

## config/dts/bindings/kscan/zmk,kscan-virtual.yaml
```yaml
# Copyright (c) 2024 The ZMK Contributors
# SPDX-License-Identifier: MIT

description: |
  Virtual KScan driver - software-defined key positions with no GPIO backing.

  This driver creates virtual switches that can be triggered by input events
  (such as from gpio-qdec encoders). The virtual keys appear in ZMK Studio
  as editable key positions.

  Each virtual key is defined by:
    - An input axis code (INPUT_REL_X, INPUT_REL_Y, etc.)
    - A direction (1 for positive/CW, -1 for negative/CCW)

  The keys are laid out as a single row: row=0, col=key_index

  Example usage:

    #include <zephyr/dt-bindings/input/input-event-codes.h>

    /* Define gpio-qdec encoders separately */
    encoder_left: encoder_left {
        compatible = "gpio-qdec";
        gpios = <&gpio0 3 (GPIO_PULL_UP | GPIO_ACTIVE_HIGH)>,
                <&gpio0 4 (GPIO_PULL_UP | GPIO_ACTIVE_HIGH)>;
        steps-per-period = <4>;
        zephyr,axis = <INPUT_REL_X>;
        sample-time-us = <2000>;
        idle-timeout-ms = <200>;
    };

    encoder_right: encoder_right {
        compatible = "gpio-qdec";
        gpios = <&gpio0 6 (GPIO_PULL_UP | GPIO_ACTIVE_HIGH)>,
                <&gpio0 7 (GPIO_PULL_UP | GPIO_ACTIVE_HIGH)>;
        steps-per-period = <4>;
        zephyr,axis = <INPUT_REL_Y>;
        sample-time-us = <2000>;
        idle-timeout-ms = <200>;
    };

    /* Virtual kscan triggered by encoder input events */
    virtual_kscan: virtual_kscan {
        compatible = "zmk,kscan-virtual";
        /* 4 virtual keys: Left CW, Left CCW, Right CW, Right CCW */
        input-codes    = <INPUT_REL_X INPUT_REL_X INPUT_REL_Y INPUT_REL_Y>;
        input-directions = <1 (-1) 1 (-1)>;
    };

compatible: "zmk,kscan-virtual"

include: kscan.yaml

properties:
  input-codes:
    type: array
    required: true
    description: |
      Array of INPUT_REL_* axis codes for each virtual key.
      Common values: INPUT_REL_X (0x00), INPUT_REL_Y (0x01), INPUT_REL_WHEEL (0x08)

  input-directions:
    type: array
    required: true
    description: |
      Array of directions for each virtual key.
      Use 1 for positive direction (CW rotation).
      Use -1 for negative direction (CCW rotation).
      Must have the same length as 'input-codes'.
```
